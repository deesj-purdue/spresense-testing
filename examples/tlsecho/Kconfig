## examples/tlsecho/Kconfig
```kconfig
config EXAMPLES_TLSECHO
	tristate "'sslutil' sample: Simple TLS Echo Client"
	default n
	---help---
		Enable the tlsecho app

if EXAMPLES_TLSECHO

config EXAMPLES_TLSECHO_PROGNAME
	string "Program name"
	default "tlsecho"
	---help---
		This is the name of the program that will be used when the NSH ELF
		program is installed.

config EXAMPLES_TLSECHO_PRIORITY
	int "tlsecho task priority"
	default 100

config EXAMPLES_TLSECHO_STACKSIZE
	int "tlsecho stack size"
	default 8192

endif
```

## examples/usb_camera/Kconfig
```kconfig
config EXAMPLES_USB_CAMERA
	tristate "USB camera streaming example"
	default n
	---help---
		Stream real camera images (JPEG or grayscale) from the Spresense
		camera board over USB CDC/ACM.  Uses the same frame protocol as
		the usb_image example so the same PC-side receiver works for both.

if EXAMPLES_USB_CAMERA

config EXAMPLES_USB_CAMERA_PROGNAME
	string "Program name"
	default "usb_camera"

config EXAMPLES_USB_CAMERA_PRIORITY
	int "usb_camera task priority"
	default 100

config EXAMPLES_USB_CAMERA_STACKSIZE
	int "usb_camera stack size"
	default 4096

endif
```

## examples/usb_image/Kconfig
```kconfig
config EXAMPLES_USB_IMAGE
	tristate "USB image sender example"
	default n
	---help---
		Send 640x480 8-bit grayscale images over USB CDC/ACM

if EXAMPLES_USB_IMAGE

config EXAMPLES_USB_IMAGE_PROGNAME
	string "Program name"
	default "usb_image"

config EXAMPLES_USB_IMAGE_PRIORITY
	int "usb_image task priority"
	default 100

config EXAMPLES_USB_IMAGE_STACKSIZE
	int "usb_image stack size"
	default 4096

endif
```
